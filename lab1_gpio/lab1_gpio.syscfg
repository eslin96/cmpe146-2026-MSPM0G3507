/**
 *
 * @cliArgs --device "MSPM0G350X" --part "Default" --package "LQFP-64(PM)" --product "mspm0_sdk@2.10.00.04"
 * @versions {"tool":"1.28.0+4696"}
 */

/**
 * Import the modules used in this configuration.
 *
 * Only clock tree (SYSCTL) and the on-board debug pins (Board) are
 * configured here. GPIO is intentionally left out — you are writing that
 * driver by hand for this lab, not generating it with SysConfig/DriverLib.
 */
const SYSCTL = scripting.addModule("/ti/driverlib/SYSCTL");

/**
 * Write custom configuration values to the imported modules.
 */
SYSCTL.forceDefaultClkConfig = true;
SYSCTL.clockTreeEn           = true;

const Board = scripting.addModule("/ti/driverlib/Board", {}, false);

/**
 * Pinmux solution for unlocked pins/peripherals. This ensures that minor changes to the automatic solver in a future
 * version of the tool will not impact the pinmux you originally saw.  These lines can be completely deleted in order to
 * re-solve from scratch.
 */
Board.peripheral.$suggestSolution          = "DEBUGSS";
Board.peripheral.swclkPin.$suggestSolution = "PA20";
Board.peripheral.swdioPin.$suggestSolution = "PA19";
